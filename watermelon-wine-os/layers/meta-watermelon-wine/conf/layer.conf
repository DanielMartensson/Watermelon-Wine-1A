## watermelon-wine-os/layers/meta-watermelon-wine/conf/machine/stm32mp257f-watermelon-wine-1a.conf
```bitbake
require conf/machine/stm32mp257f.conf

CUBEMX_PROJECT = "${TOPDIR}/../layers/meta-watermelon-wine/cubemx/CA35/DeviceTree/watermelon-wine-1a"
CUBEMX_PROJECT_NAME = "watermelon-wine-1a"
CUBEMX_DTB = "stm32mp257f-watermelon-wine-1a-mx"
```
